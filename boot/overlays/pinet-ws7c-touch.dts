// Waveshare 7inch DSI LCD (C) 1024x600 touch fix-up.
// vc4-kms-dsi-waveshare-panel,7_0_inchC hardcodes the GT911 at 0x14 and an
// 800x480 touch range; this panel answers at 0x5d and reports 1024x600.
//
// Build + install on the Pi:
//   dtc -@ -q -I dts -O dtb -o /tmp/pinet-ws7c-touch.dtbo pinet-ws7c-touch.dts
//   sudo install -o root -g root -m 755 /tmp/pinet-ws7c-touch.dtbo /boot/firmware/overlays/
// /boot/firmware/config.txt, under [all], in this order:
//   dtoverlay=vc4-kms-dsi-waveshare-panel,7_0_inchC
//   dtoverlay=pinet-ws7c-touch
/dts-v1/;
/plugin/;
/ {
	compatible = "brcm,bcm2835";
	fragment@0 {
		target-path = "/soc/i2c0mux/i2c@1/goodix@14";
		__overlay__ { reg = <0x5d>; touchscreen-size-x = <1024>; touchscreen-size-y = <600>; };
	};
};
